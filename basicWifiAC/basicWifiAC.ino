#include <TickerScheduler.h>
#include <ESP8266WiFi.h>
#include <WiFiClientSecure.h>
#include <IRremoteESP8266.h>
#include <IRsend.h>
#include <IRrecv.h>
#include <IRutils.h>
#include <Ticker.h>

uint16_t stopAir[]={0x235A,0x1130,0x1C2,0x6D6,0x1C2,0x6D6,0x1F4,0x28A,0x1C2,0x2BC,0x1C2,0x2BC,0x190,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0x320,0x15E};
uint16_t startWith24Heat[]={0x22C4,0x11F8,0x12C,0x76C,0x15E,0x73A,0x15E,0x320,0x12C,0x76C,0x15E,0x320,0x15E,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0x2EE,0x190};
IRsend irsend(4);
const char* ssid = "PandoraBox-hhehe";
const char* password = "taobao#1";
int current=0;

void sendCode(uint16_t rawCodes[]){
  irsend.sendRaw(rawCodes, 147, 38);
}

char* turnAC(int aim){
  Serial.print("aim ");
  Serial.println(aim,DEC);
  if(aim==1){
    sendCode(startWith24Heat);
    current=1;
    return "started!";
  }else if (aim==0){
    sendCode(stopAir);
    current=0;
    return "stopped!";
  }
}

const char* host = "coding.net";
const int httpsPort = 443;
int lastOnlineStatus=0;
bool checkOnlineStatus(){
  int currentStatus;
  WiFiClientSecure client;
  Serial.print("connecting to ");
  Serial.println(host);
  if (!client.connect(host, httpsPort)) {
    Serial.println("connection failed");
    return false;
  }
  String url = "/u/czjxy881/p/home_status/git/raw/master/ac";
  Serial.print("requesting URL: ");
  Serial.println(url);

  client.print(String("GET ") + url + " HTTP/1.1\r\n" +
               "Host: " + host + "\r\n" + "User-Agent: curl/7.54.0\r\nAccept: */*\r\n"+
               "Connection: close\r\n\r\n");

  Serial.println("request sent");
  while (client.connected()) {
    String line = client.readStringUntil('\n');
    if (line == "\r") {
      Serial.println("headers received");
      break;
    }
  }
  String ttt = client.readStringUntil('\n');
  Serial.println(ttt);
  if (ttt.startsWith("1")) {
    currentStatus=1;
  } else if (ttt.startsWith("0")) {
    currentStatus=0;
  }else{
    Serial.println("unknown status");
    currentStatus=lastOnlineStatus;
  }
  if(currentStatus!=lastOnlineStatus){
    turnAC(currentStatus);
  }
  lastOnlineStatus=currentStatus;
  return true;
}

TickerScheduler ts(5);


// Create an instance of the server
// specify the port to listen on as an argument
WiFiServer server(80);

void setup() {
  irsend.begin();
  Serial.begin(115200);
  delay(10);

  // prepare GPIO2
  pinMode(2, OUTPUT);
  digitalWrite(2, 1);
  
  // Connect to WiFi network
  Serial.println();
  Serial.println();
  Serial.print("Connecting to ");
  Serial.println(ssid);
  
  WiFi.mode(WIFI_STA);
  WiFi.begin(ssid, password);
  
  while (WiFi.status() != WL_CONNECTED) {
    delay(500);
    Serial.print(".");
  }
  Serial.println("");
  Serial.println("WiFi connected");
  
  // Start the server
  server.begin();
  Serial.println("Server started");

  // Print the IP address
  Serial.println(WiFi.localIP());
  ts.add(0,10000,checkOnlineStatus,true);
}



void loop() {
  // Check if a client has connected
  ts.update();
  WiFiClient client = server.available();
  if (!client) {
    return;
  }
  
  // Wait until the client sends some data
  Serial.println("new client");
  while(!client.available()){
    delay(1);
  }
  
  // Read the first line of the request
  String req = client.readStringUntil('\r');
  String result;
  Serial.println(req);
  client.flush();
  
  // Match the request
  if (req.indexOf("/ac/on") != -1){
    result=turnAC(1);
  }else if (req.indexOf("/ac/off") != -1){
    result=turnAC(0);
  }else if (req.indexOf("/ac/status") != -1){
    result=current?"started":"stopped";
  }else {
    Serial.println("invalid request");
    client.stop();
    return;
  }
  
  client.flush();

  // Prepare the response
  String s = "HTTP/1.1 200 OK\r\nContent-Type: text/html\r\n\r\n<!DOCTYPE HTML>\r\n<html>\r\nac ";
  s += result;
  s += "</html>\n";

  // Send the response to the client
  client.print(s);
  delay(1);
  Serial.println("Client disonnected");
  
  
  

  // The client will actually be disconnected 
  // when the function returns and 'client' object is detroyed
}

